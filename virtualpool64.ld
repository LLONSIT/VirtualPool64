SECTIONS
{
    __romPos = 0;
    _gp = 0x0;
    header_ROM_START = __romPos;
    header_VRAM = ADDR(.header);
    .header : AT(header_ROM_START) SUBALIGN(16)
    {
        header_DATA_START = .;
        header_s = .;
        build/asm/header.s.o(.data);
        header_DATA_END = .;
        header_DATA_SIZE = ABSOLUTE(header_DATA_END - header_DATA_START);
    }
    __romPos += SIZEOF(.header);
    header_ROM_END = __romPos;
    header_VRAM_END = .;

    boot_ROM_START = __romPos;
    boot_VRAM = ADDR(.boot);
    .boot : AT(boot_ROM_START) SUBALIGN(16)
    {
        boot_DATA_START = .;
        boot_bin = .;
        build/assets/boot.bin.o(.data);
        boot_DATA_END = .;
        boot_DATA_SIZE = ABSOLUTE(boot_DATA_END - boot_DATA_START);
    }
    __romPos += SIZEOF(.boot);
    boot_ROM_END = __romPos;
    boot_VRAM_END = .;

    main_ROM_START = __romPos;
    main_VRAM = ADDR(.main);
    .main 0x80000400 : AT(main_ROM_START) SUBALIGN(16)
    {
        main_TEXT_START = .;
        build/src/code_1000.c.o(.text);
        build/asm/11A0.s.o(.text);
        build/asm/1550.s.o(.text);
        build/asm/1670.s.o(.text);
        build/asm/16B0.s.o(.text);
        build/asm/17B0.s.o(.text);
        build/asm/1860.s.o(.text);
        build/asm/2330.s.o(.text);
        build/asm/23B0.s.o(.text);
        build/asm/2450.s.o(.text);
        build/asm/2590.s.o(.text);
        build/asm/25F0.s.o(.text);
        build/asm/26C0.s.o(.text);
        build/asm/2720.s.o(.text);
        build/asm/2780.s.o(.text);
        build/asm/2790.s.o(.text);
        build/asm/27B0.s.o(.text);
        build/asm/2F00.s.o(.text);
        build/asm/30D0.s.o(.text);
        build/asm/3190.s.o(.text);
        build/asm/33F0.s.o(.text);
        build/asm/3420.s.o(.text);
        build/asm/3440.s.o(.text);
        build/asm/3800.s.o(.text);
        build/asm/38F0.s.o(.text);
        build/asm/3A20.s.o(.text);
        build/asm/3A70.s.o(.text);
        build/asm/3C30.s.o(.text);
        build/asm/4110.s.o(.text);
        build/asm/4380.s.o(.text);
        build/asm/44A0.s.o(.text);
        build/asm/4E90.s.o(.text);
        build/asm/5020.s.o(.text);
        build/asm/5F90.s.o(.text);
        build/asm/C610.s.o(.text);
        build/asm/D1A0.s.o(.text);
        build/asm/D7D0.s.o(.text);
        build/asm/E250.s.o(.text);
        build/asm/E740.s.o(.text);
        build/asm/E810.s.o(.text);
        build/asm/111B0.s.o(.text);
        build/asm/15460.s.o(.text);
        build/asm/17E60.s.o(.text);
        build/asm/19130.s.o(.text);
        build/asm/1D500.s.o(.text);
        build/asm/1E5E0.s.o(.text);
        build/asm/1FDF0.s.o(.text);
        build/asm/21B20.s.o(.text);
        build/asm/22DC0.s.o(.text);
        build/asm/230D0.s.o(.text);
        build/asm/248E0.s.o(.text);
        build/asm/24950.s.o(.text);
        build/asm/24C60.s.o(.text);
        build/asm/25210.s.o(.text);
        build/asm/27E20.s.o(.text);
        build/asm/2C440.s.o(.text);
        build/asm/2EEC0.s.o(.text);
        build/asm/30040.s.o(.text);
        build/asm/30A60.s.o(.text);
        build/asm/41A60.s.o(.text);
        build/asm/46B80.s.o(.text);
        build/asm/4A2D0.s.o(.text);
        build/asm/4B020.s.o(.text);
        build/asm/4C230.s.o(.text);
        build/asm/4C880.s.o(.text);
        build/asm/52720.s.o(.text);
        build/asm/536D0.s.o(.text);
        build/asm/57CA0.s.o(.text);
        build/asm/5B2A0.s.o(.text);
        build/asm/5D600.s.o(.text);
        build/asm/61410.s.o(.text);
        build/asm/626C0.s.o(.text);
        build/asm/648F0.s.o(.text);
        build/asm/64B40.s.o(.text);
        build/asm/65650.s.o(.text);
        build/asm/746D0.s.o(.text);
        build/asm/77050.s.o(.text);
        build/asm/7A790.s.o(.text);
        build/asm/7BE20.s.o(.text);
        build/asm/7E140.s.o(.text);
        build/asm/7FAF0.s.o(.text);
        build/asm/8B3F0.s.o(.text);
        build/asm/8BA70.s.o(.text);
        build/asm/8C3D0.s.o(.text);
        build/asm/8EF90.s.o(.text);
        main_TEXT_END = .;
        main_TEXT_SIZE = ABSOLUTE(main_TEXT_END - main_TEXT_START);
        main_DATA_START = .;
        code_1000_c = .;
        build/src/code_1000.c.o(.data);
        _11A0_s = .;
        build/asm/11A0.s.o(.data);
        _1550_s = .;
        build/asm/1550.s.o(.data);
        _1670_s = .;
        build/asm/1670.s.o(.data);
        _16B0_s = .;
        build/asm/16B0.s.o(.data);
        _17B0_s = .;
        build/asm/17B0.s.o(.data);
        _1860_s = .;
        build/asm/1860.s.o(.data);
        _2330_s = .;
        build/asm/2330.s.o(.data);
        _23B0_s = .;
        build/asm/23B0.s.o(.data);
        _2450_s = .;
        build/asm/2450.s.o(.data);
        _2590_s = .;
        build/asm/2590.s.o(.data);
        _25F0_s = .;
        build/asm/25F0.s.o(.data);
        _26C0_s = .;
        build/asm/26C0.s.o(.data);
        _2720_s = .;
        build/asm/2720.s.o(.data);
        _2780_s = .;
        build/asm/2780.s.o(.data);
        _2790_s = .;
        build/asm/2790.s.o(.data);
        _27B0_s = .;
        build/asm/27B0.s.o(.data);
        _2F00_s = .;
        build/asm/2F00.s.o(.data);
        _30D0_s = .;
        build/asm/30D0.s.o(.data);
        _3190_s = .;
        build/asm/3190.s.o(.data);
        _33F0_s = .;
        build/asm/33F0.s.o(.data);
        _3420_s = .;
        build/asm/3420.s.o(.data);
        _3440_s = .;
        build/asm/3440.s.o(.data);
        _3800_s = .;
        build/asm/3800.s.o(.data);
        _38F0_s = .;
        build/asm/38F0.s.o(.data);
        _3A20_s = .;
        build/asm/3A20.s.o(.data);
        _3A70_s = .;
        build/asm/3A70.s.o(.data);
        _3C30_s = .;
        build/asm/3C30.s.o(.data);
        _4110_s = .;
        build/asm/4110.s.o(.data);
        _4380_s = .;
        build/asm/4380.s.o(.data);
        _44A0_s = .;
        build/asm/44A0.s.o(.data);
        _4E90_s = .;
        build/asm/4E90.s.o(.data);
        _5020_s = .;
        build/asm/5020.s.o(.data);
        _5F90_s = .;
        build/asm/5F90.s.o(.data);
        C610_s = .;
        build/asm/C610.s.o(.data);
        D1A0_s = .;
        build/asm/D1A0.s.o(.data);
        D7D0_s = .;
        build/asm/D7D0.s.o(.data);
        E250_s = .;
        build/asm/E250.s.o(.data);
        E740_s = .;
        build/asm/E740.s.o(.data);
        E810_s = .;
        build/asm/E810.s.o(.data);
        _111B0_s = .;
        build/asm/111B0.s.o(.data);
        _15460_s = .;
        build/asm/15460.s.o(.data);
        _17E60_s = .;
        build/asm/17E60.s.o(.data);
        _19130_s = .;
        build/asm/19130.s.o(.data);
        _1D500_s = .;
        build/asm/1D500.s.o(.data);
        _1E5E0_s = .;
        build/asm/1E5E0.s.o(.data);
        _1FDF0_s = .;
        build/asm/1FDF0.s.o(.data);
        _21B20_s = .;
        build/asm/21B20.s.o(.data);
        _22DC0_s = .;
        build/asm/22DC0.s.o(.data);
        _230D0_s = .;
        build/asm/230D0.s.o(.data);
        _248E0_s = .;
        build/asm/248E0.s.o(.data);
        _24950_s = .;
        build/asm/24950.s.o(.data);
        _24C60_s = .;
        build/asm/24C60.s.o(.data);
        _25210_s = .;
        build/asm/25210.s.o(.data);
        _27E20_s = .;
        build/asm/27E20.s.o(.data);
        _2C440_s = .;
        build/asm/2C440.s.o(.data);
        _2EEC0_s = .;
        build/asm/2EEC0.s.o(.data);
        _30040_s = .;
        build/asm/30040.s.o(.data);
        _30A60_s = .;
        build/asm/30A60.s.o(.data);
        _41A60_s = .;
        build/asm/41A60.s.o(.data);
        _46B80_s = .;
        build/asm/46B80.s.o(.data);
        _4A2D0_s = .;
        build/asm/4A2D0.s.o(.data);
        _4B020_s = .;
        build/asm/4B020.s.o(.data);
        _4C230_s = .;
        build/asm/4C230.s.o(.data);
        _4C880_s = .;
        build/asm/4C880.s.o(.data);
        _52720_s = .;
        build/asm/52720.s.o(.data);
        _536D0_s = .;
        build/asm/536D0.s.o(.data);
        _57CA0_s = .;
        build/asm/57CA0.s.o(.data);
        _5B2A0_s = .;
        build/asm/5B2A0.s.o(.data);
        _5D600_s = .;
        build/asm/5D600.s.o(.data);
        _61410_s = .;
        build/asm/61410.s.o(.data);
        _626C0_s = .;
        build/asm/626C0.s.o(.data);
        _648F0_s = .;
        build/asm/648F0.s.o(.data);
        _64B40_s = .;
        build/asm/64B40.s.o(.data);
        _65650_s = .;
        build/asm/65650.s.o(.data);
        _746D0_s = .;
        build/asm/746D0.s.o(.data);
        _77050_s = .;
        build/asm/77050.s.o(.data);
        _7A790_s = .;
        build/asm/7A790.s.o(.data);
        _7BE20_s = .;
        build/asm/7BE20.s.o(.data);
        _7E140_s = .;
        build/asm/7E140.s.o(.data);
        _7FAF0_s = .;
        build/asm/7FAF0.s.o(.data);
        _8B3F0_s = .;
        build/asm/8B3F0.s.o(.data);
        _8BA70_s = .;
        build/asm/8BA70.s.o(.data);
        _8C3D0_s = .;
        build/asm/8C3D0.s.o(.data);
        _8EF90_s = .;
        build/asm/8EF90.s.o(.data);
        main_DATA_END = .;
        main_DATA_SIZE = ABSOLUTE(main_DATA_END - main_DATA_START);
        main_RODATA_START = .;
        build/src/code_1000.c.o(.rodata);
        build/asm/11A0.s.o(.rodata);
        build/asm/1550.s.o(.rodata);
        build/asm/1670.s.o(.rodata);
        build/asm/16B0.s.o(.rodata);
        build/asm/17B0.s.o(.rodata);
        build/asm/1860.s.o(.rodata);
        build/asm/2330.s.o(.rodata);
        build/asm/23B0.s.o(.rodata);
        build/asm/2450.s.o(.rodata);
        build/asm/2590.s.o(.rodata);
        build/asm/25F0.s.o(.rodata);
        build/asm/26C0.s.o(.rodata);
        build/asm/2720.s.o(.rodata);
        build/asm/2780.s.o(.rodata);
        build/asm/2790.s.o(.rodata);
        build/asm/27B0.s.o(.rodata);
        build/asm/2F00.s.o(.rodata);
        build/asm/30D0.s.o(.rodata);
        build/asm/3190.s.o(.rodata);
        build/asm/33F0.s.o(.rodata);
        build/asm/3420.s.o(.rodata);
        build/asm/3440.s.o(.rodata);
        build/asm/3800.s.o(.rodata);
        build/asm/38F0.s.o(.rodata);
        build/asm/3A20.s.o(.rodata);
        build/asm/3A70.s.o(.rodata);
        build/asm/3C30.s.o(.rodata);
        build/asm/4110.s.o(.rodata);
        build/asm/4380.s.o(.rodata);
        build/asm/44A0.s.o(.rodata);
        build/asm/4E90.s.o(.rodata);
        build/asm/5020.s.o(.rodata);
        build/asm/5F90.s.o(.rodata);
        build/asm/C610.s.o(.rodata);
        build/asm/D1A0.s.o(.rodata);
        build/asm/D7D0.s.o(.rodata);
        build/asm/E250.s.o(.rodata);
        build/asm/E740.s.o(.rodata);
        build/asm/E810.s.o(.rodata);
        build/asm/111B0.s.o(.rodata);
        build/asm/15460.s.o(.rodata);
        build/asm/17E60.s.o(.rodata);
        build/asm/19130.s.o(.rodata);
        build/asm/1D500.s.o(.rodata);
        build/asm/1E5E0.s.o(.rodata);
        build/asm/1FDF0.s.o(.rodata);
        build/asm/21B20.s.o(.rodata);
        build/asm/22DC0.s.o(.rodata);
        build/asm/230D0.s.o(.rodata);
        build/asm/248E0.s.o(.rodata);
        build/asm/24950.s.o(.rodata);
        build/asm/24C60.s.o(.rodata);
        build/asm/25210.s.o(.rodata);
        build/asm/27E20.s.o(.rodata);
        build/asm/2C440.s.o(.rodata);
        build/asm/2EEC0.s.o(.rodata);
        build/asm/30040.s.o(.rodata);
        build/asm/30A60.s.o(.rodata);
        build/asm/41A60.s.o(.rodata);
        build/asm/46B80.s.o(.rodata);
        build/asm/4A2D0.s.o(.rodata);
        build/asm/4B020.s.o(.rodata);
        build/asm/4C230.s.o(.rodata);
        build/asm/4C880.s.o(.rodata);
        build/asm/52720.s.o(.rodata);
        build/asm/536D0.s.o(.rodata);
        build/asm/57CA0.s.o(.rodata);
        build/asm/5B2A0.s.o(.rodata);
        build/asm/5D600.s.o(.rodata);
        build/asm/61410.s.o(.rodata);
        build/asm/626C0.s.o(.rodata);
        build/asm/648F0.s.o(.rodata);
        build/asm/64B40.s.o(.rodata);
        build/asm/65650.s.o(.rodata);
        build/asm/746D0.s.o(.rodata);
        build/asm/77050.s.o(.rodata);
        build/asm/7A790.s.o(.rodata);
        build/asm/7BE20.s.o(.rodata);
        build/asm/7E140.s.o(.rodata);
        build/asm/7FAF0.s.o(.rodata);
        build/asm/8B3F0.s.o(.rodata);
        build/asm/8BA70.s.o(.rodata);
        build/asm/8C3D0.s.o(.rodata);
        build/asm/8EF90.s.o(.rodata);
        main_RODATA_END = .;
        main_RODATA_SIZE = ABSOLUTE(main_RODATA_END - main_RODATA_START);
    }
    main_bss_VRAM = ADDR(.main_bss);
    .main_bss (NOLOAD) : SUBALIGN(16)
    {
        main_BSS_START = .;
        build/src/code_1000.c.o(.bss);
        build/asm/11A0.s.o(.bss);
        build/asm/1550.s.o(.bss);
        build/asm/1670.s.o(.bss);
        build/asm/16B0.s.o(.bss);
        build/asm/17B0.s.o(.bss);
        build/asm/1860.s.o(.bss);
        build/asm/2330.s.o(.bss);
        build/asm/23B0.s.o(.bss);
        build/asm/2450.s.o(.bss);
        build/asm/2590.s.o(.bss);
        build/asm/25F0.s.o(.bss);
        build/asm/26C0.s.o(.bss);
        build/asm/2720.s.o(.bss);
        build/asm/2780.s.o(.bss);
        build/asm/2790.s.o(.bss);
        build/asm/27B0.s.o(.bss);
        build/asm/2F00.s.o(.bss);
        build/asm/30D0.s.o(.bss);
        build/asm/3190.s.o(.bss);
        build/asm/33F0.s.o(.bss);
        build/asm/3420.s.o(.bss);
        build/asm/3440.s.o(.bss);
        build/asm/3800.s.o(.bss);
        build/asm/38F0.s.o(.bss);
        build/asm/3A20.s.o(.bss);
        build/asm/3A70.s.o(.bss);
        build/asm/3C30.s.o(.bss);
        build/asm/4110.s.o(.bss);
        build/asm/4380.s.o(.bss);
        build/asm/44A0.s.o(.bss);
        build/asm/4E90.s.o(.bss);
        build/asm/5020.s.o(.bss);
        build/asm/5F90.s.o(.bss);
        build/asm/C610.s.o(.bss);
        build/asm/D1A0.s.o(.bss);
        build/asm/D7D0.s.o(.bss);
        build/asm/E250.s.o(.bss);
        build/asm/E740.s.o(.bss);
        build/asm/E810.s.o(.bss);
        build/asm/111B0.s.o(.bss);
        build/asm/15460.s.o(.bss);
        build/asm/17E60.s.o(.bss);
        build/asm/19130.s.o(.bss);
        build/asm/1D500.s.o(.bss);
        build/asm/1E5E0.s.o(.bss);
        build/asm/1FDF0.s.o(.bss);
        build/asm/21B20.s.o(.bss);
        build/asm/22DC0.s.o(.bss);
        build/asm/230D0.s.o(.bss);
        build/asm/248E0.s.o(.bss);
        build/asm/24950.s.o(.bss);
        build/asm/24C60.s.o(.bss);
        build/asm/25210.s.o(.bss);
        build/asm/27E20.s.o(.bss);
        build/asm/2C440.s.o(.bss);
        build/asm/2EEC0.s.o(.bss);
        build/asm/30040.s.o(.bss);
        build/asm/30A60.s.o(.bss);
        build/asm/41A60.s.o(.bss);
        build/asm/46B80.s.o(.bss);
        build/asm/4A2D0.s.o(.bss);
        build/asm/4B020.s.o(.bss);
        build/asm/4C230.s.o(.bss);
        build/asm/4C880.s.o(.bss);
        build/asm/52720.s.o(.bss);
        build/asm/536D0.s.o(.bss);
        build/asm/57CA0.s.o(.bss);
        build/asm/5B2A0.s.o(.bss);
        build/asm/5D600.s.o(.bss);
        build/asm/61410.s.o(.bss);
        build/asm/626C0.s.o(.bss);
        build/asm/648F0.s.o(.bss);
        build/asm/64B40.s.o(.bss);
        build/asm/65650.s.o(.bss);
        build/asm/746D0.s.o(.bss);
        build/asm/77050.s.o(.bss);
        build/asm/7A790.s.o(.bss);
        build/asm/7BE20.s.o(.bss);
        build/asm/7E140.s.o(.bss);
        build/asm/7FAF0.s.o(.bss);
        build/asm/8B3F0.s.o(.bss);
        build/asm/8BA70.s.o(.bss);
        build/asm/8C3D0.s.o(.bss);
        build/asm/8EF90.s.o(.bss);
        main_BSS_END = .;
        main_BSS_SIZE = ABSOLUTE(main_BSS_END - main_BSS_START);
    }
    __romPos += SIZEOF(.main);
    __romPos = ALIGN(__romPos, 16);
    main_ROM_END = __romPos;
    main_VRAM_END = .;

    _9CDE0_ROM_START = __romPos;
    _9CDE0_VRAM = ADDR(._9CDE0);
    ._9CDE0 : AT(_9CDE0_ROM_START) SUBALIGN(16)
    {
        _9CDE0_DATA_START = .;
        _9CDE0_bin = .;
        build/assets/9CDE0.bin.o(.data);
        _9CDE0_DATA_END = .;
        _9CDE0_DATA_SIZE = ABSOLUTE(_9CDE0_DATA_END - _9CDE0_DATA_START);
    }
    __romPos += SIZEOF(._9CDE0);
    _9CDE0_ROM_END = __romPos;
    _9CDE0_VRAM_END = .;

    /DISCARD/ :
    {
        *(*);
    }
}
